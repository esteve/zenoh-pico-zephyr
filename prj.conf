## CMakeLists.txt
```
# SPDX-License-Identifier: Apache-2.0

cmake_minimum_required(VERSION 3.13.1)
find_package(Zephyr REQUIRED HINTS $ENV{ZEPHYR_BASE})
project(zenoh_app_intree)

set(ZENOH_PICO_SRC_PATH $ENV{ZENOH_PICO_SRC_PATH})

if("${ZENOH_PICO_SRC_PATH}" STREQUAL "")
  message(FATAL_ERROR
    "Please set ZENOH_PICO_SRC_PATH environment variable to where your copy of the zenoh-pico repository is")
endif()

target_sources(app PRIVATE
  ${ZENOH_PICO_SRC_PATH}/src/codec.c
  ${ZENOH_PICO_SRC_PATH}/src/collection.c
  ${ZENOH_PICO_SRC_PATH}/src/iobuf.c
  ${ZENOH_PICO_SRC_PATH}/src/utils.c
  ${ZENOH_PICO_SRC_PATH}/src/compat/strdup.c
  ${ZENOH_PICO_SRC_PATH}/src/net/codec.c
  ${ZENOH_PICO_SRC_PATH}/src/net/internal.c
  ${ZENOH_PICO_SRC_PATH}/src/net/lease_task.c
  ${ZENOH_PICO_SRC_PATH}/src/net/msgcodec.c
  ${ZENOH_PICO_SRC_PATH}/src/net/property.c
  ${ZENOH_PICO_SRC_PATH}/src/net/read_task.c
  ${ZENOH_PICO_SRC_PATH}/src/net/rname.c
  ${ZENOH_PICO_SRC_PATH}/src/net/session.c
  ${ZENOH_PICO_SRC_PATH}/src/net/zephyr/network.c
  ${ZENOH_PICO_SRC_PATH}/src/net/zephyr/system.c
  src/main.c)
target_include_directories(app PRIVATE ${ZENOH_PICO_SRC_PATH}/include/)
target_compile_definitions(app PRIVATE -DZENOH_ZEPHYR -DZENOH_NEEDS_STRDUP)
```

## prj.conf
```kconfig
# Generic networking options
CONFIG_NETWORKING=y
CONFIG_NET_UDP=y
CONFIG_NET_TCP=y
CONFIG_NET_IPV6=n
CONFIG_NET_IPV4=y
CONFIG_NET_SOCKETS=y
CONFIG_NET_SOCKETS_POSIX_NAMES=y
CONFIG_NET_SOCKETS_POLL_MAX=4
CONFIG_NET_CONNECTION_MANAGER=y

# Kernel options
CONFIG_MAIN_STACK_SIZE=2048
CONFIG_ENTROPY_GENERATOR=y
CONFIG_TEST_RANDOM_GENERATOR=y
CONFIG_INIT_STACKS=y

# Logging
CONFIG_NET_LOG=y
CONFIG_LOG=y
CONFIG_NET_STATISTICS=y
CONFIG_PRINTK=y

# Network buffers
CONFIG_NET_PKT_RX_COUNT=16
CONFIG_NET_PKT_TX_COUNT=16
CONFIG_NET_BUF_RX_COUNT=80
CONFIG_NET_BUF_TX_COUNT=80
CONFIG_NET_CONTEXT_NET_PKT_POOL=y

# IP address options
CONFIG_NET_IF_UNICAST_IPV6_ADDR_COUNT=3
CONFIG_NET_IF_MCAST_IPV6_ADDR_COUNT=4
CONFIG_NET_MAX_CONTEXTS=10

# Network shell
CONFIG_NET_SHELL=y

# The addresses are selected so that qemu<->qemu connectivity works ok.
# For linux<->qemu connectivity, create a new conf file and swap the
# addresses (so that peer address is ending to 2).
CONFIG_NET_CONFIG_SETTINGS=y
CONFIG_NET_CONFIG_NEED_IPV6=y
CONFIG_NET_CONFIG_MY_IPV6_ADDR="2001:db8::2"
CONFIG_NET_CONFIG_PEER_IPV6_ADDR="2001:db8::1"
CONFIG_NET_CONFIG_NEED_IPV4=y

CONFIG_NET_CONFIG_MY_IPV4_ADDR="192.168.33.117"
CONFIG_NET_CONFIG_MY_IPV4_NETMASK="255.255.252.0"
CONFIG_NET_CONFIG_MY_IPV4_GW="192.168.32.1"
CONFIG_NET_CONFIG_PEER_IPV4_ADDR="192.168.34.196"

CONFIG_NEWLIB_LIBC=y
CONFIG_NEWLIB_LIBC_NANO=n
CONFIG_POSIX_API=y
```

## src/main.c
```c
#include <zephyr.h>
#include <stdio.h>
#include <unistd.h>
#include <string.h>
#include <zenoh-pico.h>

#define ZENOH_ROUTER_PORT "7447"
#define ZENOH_ROUTER_ADDR CONFIG_NET_CONFIG_PEER_IPV4_ADDR
#define ZENOH_LOCATOR "tcp/" ZENOH_ROUTER_ADDR ":" ZENOH_ROUTER_PORT

int main(int argc, char **argv)
{
    char *uri = "/demo/example/zenoh-pico-pub";
    char *value = "Pub from pico!";

    zn_properties_t *config = zn_config_default();
    zn_properties_insert(config, ZN_CONFIG_PEER_KEY, z_string_make(ZENOH_LOCATOR));

    printf("Opening session...\n");
    zn_session_t *s = zn_open(config);
    if (s == 0)
    {
        printf("Unable to open session!\n");
        _exit(-1);
    }

    // Start the receive and the session lease loop for zenoh-pico
    znp_start_read_task(s);
    znp_start_lease_task(s);

    printf("Declaring Resource '%s'", uri);
    unsigned long rid = zn_declare_resource(s, zn_rname(uri));
    printf(" => RId %lu\n", rid);
    zn_reskey_t reskey = zn_rid(rid);

    printf("Declaring Publisher on %lu\n", rid);
    zn_publisher_t *pub = zn_declare_publisher(s, reskey);
    if (pub == 0)
    {
        printf("Unable to declare publisher.\n");
        _exit(-1);
    }

    char buf[256];
    for (int idx = 0; 1; ++idx)
    {
        sleep(1);
        sprintf(buf, "[%4d] %s", idx, value);
        printf("Writing Data ('%lu': '%s')...\n", rid, buf);
        zn_write(s, reskey, (const uint8_t *)buf, strlen(buf));
    }

    zn_undeclare_publisher(pub);
    zn_close(s);

    return 0;
}
```
